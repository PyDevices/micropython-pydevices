## modules/btaudio/tests/idf_app/sdkconfig.defaults
```kconfig
CONFIG_BT_ENABLED=y
CONFIG_BT_BLUEDROID_ENABLED=y
CONFIG_BT_CLASSIC_ENABLED=y
CONFIG_BT_BLE_ENABLED=n
CONFIG_BT_A2DP_ENABLE=y
CONFIG_BT_AVRCP_ENABLED=y
CONFIG_BT_SSP_ENABLED=y
CONFIG_COMPILER_WARN_WRITE_STRINGS=y
```
